## base_external/package/aesd-assignments/Config.in
```kconfig
config BR2_PACKAGE_AESD_ASSIGNMENTS
    bool "aesd-assignments"
    depends on BR2_PACKAGE_HOST_GIT
    help
      This is a custom package for the assignments 3 and later repository.
```
